/*
 * ld directives the for kernel
 */

FORCE_COMMON_ALLOCATION

SECTIONS {
	/* The kernel starts at 1M */
	. = 0x100000;

	_start = .;

	.text ALIGN(0x1000) : {
        */crt0.o(.text)
        . = NEXT(0x1000);
        _text_start = .;
		*(.text)
		_text_end = ALIGN(0x1000);
	}

    .multiboot ALIGN(0x1000) : {
        _multiboot_start = .;
        *(.multiboot)
        . = NEXT(0x1000);
        _multiboot_end = .;
    }

    .bootstrap_stack ALIGN(0x1000) : {
        _bootstrap_stack_start = .;
        *(.bootstrap_stack)
        . = NEXT(0x1000);
        _bootstrap_stack_end = .;
    }

    .rodata ALIGN(0x1000) : {
        _rodata_start = .;
        *(.rodata)
        *(.rodata.str1.1)
        *(.rodata.str1.4)
        *(.rodata.str1.32)
        *(.rodata.cst8)
        /*
         * Include the linker script generated by the toolchain which will
         * define where userspace apps will be linked. The file is located in
         * $(OUTPUT)/ but the -L flag of ld allows us to not depends on this path
         * here, and let the Makefile manage that.
         */
        INCLUDE apps.lds
        _rodata_end = ALIGN(0x1000);
    }

	.data ALIGN(0x1000) : {
        _data_start = .;
		__CTOR_LIST__ = .;
		LONG((__CTOR_END__ - __CTOR_LIST__) / 4 - 2)
		*(.ctors)
		LONG(0)
		__CTOR_END__ = .;
		__DTOR_LIST__ = .;
		LONG((__DTOR_END__ - __DTOR_LIST__) / 4 - 2)
		*(.dtors)
		LONG(0)
		__DTOR_END__ = .;

		*(.fini)
		*(.anno)
		*(__ex_table)
		*(.data)

		task_dump_screen = .;
		*(.task_dump_screen)

        /* Real mode code */
        realmode_start = .;
        *(.real-mode)
        realmode_end = .;
		
        _data_end = ALIGN(0x1000);
	}

	.bss ALIGN(0x1000) : {
		_bss_start = .;
		*(.bss)
		*(COMMON)
		_bss_end = ALIGN(0x1000);
	}

	_end = .;

	/DISCARD/ : {
		*(.comment)
	}

	/* The memory map */
	idt = 0x1000;
	gdt = 0x10000;
	tss = 0x20000;

	/* Beginning of kernel memory heap */
	mem_heap = _end;

	/* End of kernel memory heap: 64MB */
    mem_heap_end = 0x4000000;

    /* End of managed memory: 256MB */
	mem_end = 0x10000000;

    /* User space start: 1GB */
    user_start = 0x40000000;
    user_run = user_start;

    /* User space end: 4GB (32 bits kernel) */
    userspace_end = 0xFFFFFFFF;
}
